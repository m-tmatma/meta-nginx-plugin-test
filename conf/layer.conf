## conf/layer.conf
```bitbake
# We have a conf and classes directory, add to BBPATH
BBPATH .= ":${LAYERDIR}"

# We have recipes-* directories, add to BBFILES
BBFILES += "${LAYERDIR}/recipes-*/*/*.bb \
            ${LAYERDIR}/recipes-*/*/*.bbappend"

BBFILE_COLLECTIONS += "meta-nginx-plugin-test"
BBFILE_PATTERN_meta-nginx-plugin-test = "^${LAYERDIR}/"
BBFILE_PRIORITY_meta-nginx-plugin-test = "6"

LAYERDEPENDS_meta-nginx-plugin-test = "core"
LAYERSERIES_COMPAT_meta-nginx-plugin-test = "kirkstone"
```
